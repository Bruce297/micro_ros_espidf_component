## examples/blink/sdkconfig.defaults
```kconfig
CONFIG_APPTRACE_DEST_JTAG=y
CONFIG_APPTRACE_POSTMORTEM_FLUSH_THRESH=512
CONFIG_APPTRACE_ONPANIC_HOST_FLUSH_TMO=512
CONFIG_APPTRACE_PENDING_DATA_SIZE_MAX=512
```

## examples/int32_sub_pub/sdkconfig.defaults
```kconfig
CONFIG_ESP_MAIN_TASK_STACK_SIZE=3000
CONFIG_ESP_TASK_WDT=n

CONFIG_ESP_WIFI_SSID="xu_pc"
CONFIG_ESP_WIFI_PASSWORD="1234567890"
CONFIG_MICRO_ROS_AGENT_IP="219.216.64.145"
CONFIG_MICRO_ROS_AGENT_PORT="8887"

CONFIG_APPTRACE_DEST_JTAG=y
CONFIG_APPTRACE_POSTMORTEM_FLUSH_THRESH=512
CONFIG_APPTRACE_ONPANIC_HOST_FLUSH_TMO=512
CONFIG_APPTRACE_PENDING_DATA_SIZE_MAX=512
```
